## drivers/input/fingerprint/Kconfig
```kconfig
# Copyright (C) MicroArray  
# MicroArray Fprint Driver Code
# Kconfig
# Date: 2017-3-15
# Version: v4.0.06
# Author: guq
# Contact: guq@microarray.com.cn

config MICROARRAY_FINGERPRINT
	tristate "MICROARRAY Fingerprint"
	default y
	---help---
	    MICROARRAY Fingerprint chip AFS121 AFS112 AFS83 TEE driver
```

## drivers/input/keyboard/aw9523/Kconfig
```kconfig
config KEYBOARD_AW9523B
  tristate "Awinic aw9523b Qwerty keyboard"
  default n
  depends on I2C
  help
    Say Y here if you want to use Awinic aw9523b Qwerty
     keyboard as input device.
```
